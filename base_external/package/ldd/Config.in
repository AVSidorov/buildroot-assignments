## base_external/package/ldd/Config.in
```kconfig
config BR2_PACKAGE_LDD
	bool "ldd"
	depends on BR2_LINUX_KERNEL
	help
	  Includes kernel modules.
	  Includes the writer executable, finder.sh and tester.sh in the kernel image.
	  Used to understand kernel modules programing.
```
